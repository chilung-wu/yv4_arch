## configs/u-boot/defconfig
```kconfig
# Facebook Yosemite4 BMC U-Boot Configuration
# Based on aspeed ast2620-a3 SoC

#
# 基本配置
#
CONFIG_ARM=y
CONFIG_ARCH_ASPEED=y
CONFIG_TARGET_EVB_AST2600=y
CONFIG_SYS_TEXT_BASE=0x80001000
CONFIG_SYS_MALLOC_F_LEN=0x2000
CONFIG_NR_DRAM_BANKS=1
CONFIG_ENV_SIZE=0x20000
CONFIG_ENV_OFFSET=0x80000
CONFIG_ENV_SECT_SIZE=0x1000
CONFIG_DM_GPIO=y
CONFIG_DEFAULT_DEVICE_TREE="aspeed-bmc-facebook-yosemite4"

#
# CPU 和 SoC 配置
#
CONFIG_ASPEED_AST2600=y
CONFIG_ASPEED_MULTIFUNCTION=y

#
# 記憶體配置 (1024MB DDR4 with ECC)
#
CONFIG_SYS_SDRAM_BASE=0x80000000
CONFIG_SYS_SDRAM_SIZE=0x40000000
CONFIG_SYS_LOAD_ADDR=0x83000000
CONFIG_SYS_INIT_SP_ADDR=0x80100000

#
# 開機載入器配置
#
CONFIG_BOOTDELAY=0
CONFIG_USE_BOOTARGS=y
CONFIG_BOOTARGS="console=ttyS4,57600n8 root=/dev/ram rw vmalloc=768M"
CONFIG_USE_BOOTCOMMAND=y
CONFIG_BOOTCOMMAND="bootm 0x20080000"

#
# FIT Image 支援 (關鍵配置)
#
CONFIG_FIT=y
CONFIG_FIT_VERBOSE=y
CONFIG_FIT_SIGNATURE=y
CONFIG_FIT_SIGNATURE_MAX_SIZE=0x10000000
CONFIG_RSA=y
CONFIG_SPL_FIT_SIGNATURE=y
CONFIG_SPL_LOAD_FIT=y
CONFIG_SPL_FIT_SOURCE="board/aspeed/evb_ast2600/fit_spl_load.its"

#
# Static-NoRootFS 特定配置
#
CONFIG_INITRD_HIGH=0xffffffff
CONFIG_FDT_HIGH=0xffffffff

#
# 命令列支援
#
CONFIG_CMD_BOOTZ=y
CONFIG_CMD_BOOTM=y
CONFIG_CMD_FDT=y
CONFIG_CMD_IMINFO=y
CONFIG_CMD_IMLS=y
CONFIG_CMD_XIMG=y
CONFIG_CMD_EDITENV=y
CONFIG_CMD_SAVEENV=y
CONFIG_CMD_ENV_EXISTS=y
CONFIG_CMD_MEMORY=y
CONFIG_CMD_MD5SUM=y
CONFIG_CMD_MEMTEST=y
CONFIG_CMD_CLK=y
CONFIG_CMD_DM=y
CONFIG_CMD_FUSE=y
CONFIG_CMD_GPIO=y
CONFIG_CMD_GPT=y
CONFIG_CMD_GPT_RENAME=y
CONFIG_CMD_I2C=y
CONFIG_CMD_MMC=y
CONFIG_CMD_PART=y
CONFIG_CMD_PCI=y
CONFIG_CMD_SF=y
CONFIG_CMD_SPI=y
CONFIG_CMD_USB=y
CONFIG_CMD_DHCP=y
CONFIG_CMD_MII=y
CONFIG_CMD_PING=y
CONFIG_CMD_CDP=y
CONFIG_CMD_SNTP=y
CONFIG_CMD_DNS=y
CONFIG_CMD_LINK_LOCAL=y
CONFIG_CMD_FAT=y
CONFIG_CMD_FS_GENERIC=y
CONFIG_CMD_UBI=y
CONFIG_CMD_UBIFS=y
CONFIG_CMD_MTDPARTS=y

#
# 網路配置
#
CONFIG_NETDEVICES=y
CONFIG_PHY_NCSI=y
CONFIG_FTGMAC100=y

#
# SPI Flash 支援 (128MB mx66l1g45g)
#
CONFIG_SPI_FLASH=y
CONFIG_DM_SPI_FLASH=y
CONFIG_SPI_FLASH_MACRONIX=y
CONFIG_SPI_FLASH_MTD=y
CONFIG_SPI_FLASH_USE_4K_SECTORS=y

#
# MTD 和 UBI 支援
#
CONFIG_MTD=y
CONFIG_DM_MTD=y
CONFIG_MTD_PARTITIONS=y
CONFIG_MTD_SPI_NOR=y
CONFIG_UBI_SILENCE_MSG=y
CONFIG_UBIFS_SILENCE_MSG=y

#
# eMMC/SD 支援
#
CONFIG_MMC=y
CONFIG_DM_MMC=y
CONFIG_MMC_SDHCI=y
CONFIG_MMC_SDHCI_ASPEED=y
CONFIG_MMC_SDHCI_SDMA=y

#
# USB 支援
#
CONFIG_USB=y
CONFIG_DM_USB=y
CONFIG_USB_EHCI_HCD=y
CONFIG_USB_EHCI_GENERIC=y
CONFIG_USB_STORAGE=y

#
# I2C 支援
#
CONFIG_DM_I2C=y
CONFIG_SYS_I2C_ASPEED=y

#
# RTC 支援
#
CONFIG_DM_RTC=y

#
# 看門狗支援
#
CONFIG_WDT=y
CONFIG_WDT_ASPEED=y

#
# GPIO 支援
#
CONFIG_DM_GPIO=y
CONFIG_ASPEED_GPIO=y

#
# 序列埠支援
#
CONFIG_DM_SERIAL=y
CONFIG_SYS_NS16550=y
CONFIG_SYS_NS16550_SERIAL=y

#
# 亂數產生器
#
CONFIG_DM_RNG=y
CONFIG_RNG_ASPEED=y

#
# 加密支援
#
CONFIG_DM_HASH=y
CONFIG_HASH_VERIFY=y
CONFIG_SHA1=y
CONFIG_SHA256=y
CONFIG_SHA_HW_ACCEL=y
CONFIG_SHA_PROG_HW_ACCEL=y

#
# 環境變數儲存
#
CONFIG_ENV_IS_IN_SPI_FLASH=y
CONFIG_ENV_SPI_BUS=0
CONFIG_ENV_SPI_CS=0
CONFIG_ENV_SPI_MAX_HZ=25000000
CONFIG_ENV_SPI_MODE=0

#
# 系統 Log
#
CONFIG_LOG=y
CONFIG_LOG_MAX_LEVEL=6
CONFIG_LOG_DEFAULT_LEVEL=6
CONFIG_LOG_CONSOLE=y

#
# Device Tree 支援
#
CONFIG_OF_CONTROL=y
CONFIG_OF_SEPARATE=y
CONFIG_OF_LIBFDT=y
CONFIG_OF_LIBFDT_OVERLAY=y

#
# SPL (Secondary Program Loader) 配置
#
CONFIG_SPL=y
CONFIG_SPL_SEPARATE_BSS=y
CONFIG_SPL_DISPLAY_PRINT=y
CONFIG_SPL_FIT_PRINT=y
CONFIG_SPL_STACK_R=y
CONFIG_SPL_STACK_R_MALLOC_SIMPLE_LEN=0x2000
CONFIG_SPL_OS_BOOT=y

#
# Falcon Mode (快速開機)
#
CONFIG_SPL_OS_BOOT=y
CONFIG_SYS_SPL_ARGS_ADDR=0x90000000

#
# 除錯和測試
#
CONFIG_DEBUG_UART=y
CONFIG_DEBUG_UART_ASPEED=y
CONFIG_DEBUG_UART_BASE=0x1e784000
CONFIG_DEBUG_UART_CLOCK=1846200
CONFIG_DEBUG_UART_SHIFT=2

#
# Security 相關
#
CONFIG_AUTOBOOT_KEYED=y
CONFIG_AUTOBOOT_STOP_STR=" "
CONFIG_AUTOBOOT_DELAY_STR="d"

#
# 檔案系統支援
#
CONFIG_FS_FAT=y
CONFIG_FAT_WRITE=y
CONFIG_FS_EXT4=y
CONFIG_EXT4_WRITE=y

#
# 壓縮支援
#
CONFIG_GZIP=y
CONFIG_LZO=y
CONFIG_LZMA=y
CONFIG_LZ4=y
CONFIG_ZSTD=y

#
# Yosemite4 特定配置
#
CONFIG_BOARD_LATE_INIT=y
CONFIG_MISC_INIT_R=y

#
# 開機來源順序
#
CONFIG_BOOT_RETRY_TIME=-1
CONFIG_RESET_TO_RETRY=y

#
# 進階功能
#
CONFIG_CMD_ASKENV=y
CONFIG_CMD_GREPENV=y
CONFIG_REGEX=y
CONFIG_LIB_RAND=y
CONFIG_CMD_UUID=y
CONFIG_RANDOM_UUID=y
CONFIG_PARTITION_UUIDS=y

#
# 網路開機支援
#
CONFIG_CMD_TFTPPUT=y
CONFIG_CMD_TFTPSRV=y
CONFIG_IP_DEFRAG=y
CONFIG_TFTP_BLOCKSIZE=1468
CONFIG_TFTP_WINDOWSIZE=1

#
# IPMI 支援
#
CONFIG_IPMI_KCS=y

#
# 多功能腳位配置
#
CONFIG_PINCTRL=y
CONFIG_PINCTRL_ASPEED_G6=y

# 效能最佳化
CONFIG_SYS_CACHELINE_SIZE=64
CONFIG_SYS_L2_PL310=y
CONFIG_SYS_PL310_BASE=0x1e700000
```
